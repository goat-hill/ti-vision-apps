/**
 * @cliArgs --device "TDA54" --part "Default" --package "AMW" --context "mcu0-m55" --product "MCU_PLUS_SDK@07.03.01"
 * @versions {"tool":"1.21.0+3721"}
 */

/**
 * Import the modules used in this configuration.
 */
const clock     = scripting.addModule("/kernel/dpl/clock");
const debug_log = scripting.addModule("/kernel/dpl/debug_log");

/**
 * Write custom configuration values to the imported modules.
 */
debug_log.enableLogZoneWarning   = false;
debug_log.enableLogZoneError     = false;
debug_log.enableUartLog          = true;
debug_log.uartLog.$name          = "CONFIG_UART0";
debug_log.uartLog.intrEnable     = "DISABLE";
debug_log.uartLog.UART.$assign   = "USART0";
debug_log.uartLog.UART.RXD.rx    = false;
debug_log.uartLog.UART.RXD.$used = false;
debug_log.uartLog.UART.TXD.$used = false;
