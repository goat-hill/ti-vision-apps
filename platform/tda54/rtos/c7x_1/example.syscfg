/**
 * @cliArgs --device "TDA54" --package "AMW" --part "Default" --context "c76ss0-0" --product "MCU_PLUS_SDK@07.03.01"
 * @versions {"tool":"1.18.999+112"}
 */

/**
 * Import the modules used in this configuration.
 */
const debug_log   = scripting.addModule("/kernel/dpl/debug_log");
const mmu_armv8   = scripting.addModule("/kernel/dpl/mmu_armv8", {}, false);
const mmu_armv81  = mmu_armv8.addInstance();
const mmu_armv82  = mmu_armv8.addInstance();
const mmu_armv83  = mmu_armv8.addInstance();
const mmu_armv84  = mmu_armv8.addInstance();
const mmu_armv85  = mmu_armv8.addInstance();
const mmu_armv86  = mmu_armv8.addInstance();
const mmu_armv87  = mmu_armv8.addInstance();
const mmu_armv88  = mmu_armv8.addInstance();
const mmu_armv89  = mmu_armv8.addInstance();
const mmu_armv810  = mmu_armv8.addInstance();
const mmu_armv811  = mmu_armv8.addInstance();
const mmu_armv812  = mmu_armv8.addInstance();
const mmu_armv813  = mmu_armv8.addInstance();
const mmu_armv814  = mmu_armv8.addInstance();
const mmu_armv815  = mmu_armv8.addInstance();
const mmu_armv816  = mmu_armv8.addInstance();

/**
 * Write custom configuration values to the imported modules.
 */

debug_log.enableSharedMemLog   = false;
debug_log.enableLogZoneWarning = false;
debug_log.enableLogZoneError   = false;
debug_log.enableUartLog        = false;
debug_log.enableCssLog         = false;

/**
 * Register region 0.
 * Region start: 0x0
 * Region end: 0x20000000
 * Read and write for both privileged and user modes.
 * No Execute for both privileged and user modes.
 * Attribute is MAIR0.
 */
mmu_armv81.$name             = "REGISTER_REGION_0";
mmu_armv81.vAddr             = 0x00000000;
mmu_armv81.pAddr             = 0x00000000;
mmu_armv81.size              = 0x20000000;
mmu_armv81.attribute         = "MAIR0";

/**
 * Register region 1.
 * Region start: 0x20000000
 * Region end: 0x40000000
 * Read and write for both privileged and user modes.
 * No Execute for both privileged and user modes.
 * Attribute is MAIR0.
 */
mmu_armv82.$name             = "REGISTER_REGION_1";
mmu_armv82.vAddr             = 0x20000000;
mmu_armv82.pAddr             = 0x20000000;
mmu_armv82.size              = 0x20000000;
mmu_armv82.attribute         = "MAIR0";

/**
 * Register region 2.
 * Region start: 0x40000000
 * Region end: 0x60000000
 * Read and write for both privileged and user modes.
 * No Execute for both privileged and user modes.
 * Attribute is MAIR0.
 */
mmu_armv83.$name             = "REGISTER_REGION_2";
mmu_armv83.vAddr             = 0x40000000;
mmu_armv83.pAddr             = 0x40000000;
mmu_armv83.size              = 0x20000000;
mmu_armv83.attribute         = "MAIR0";

/**
 * FSS region.
 * Region start: 0x60000000
 * Region end: 0x64000000
 * Read and write for both privileged and user modes.
 * No Execute for both privileged and user modes.
 * Attribute is MAIR0.
 */
mmu_armv84.$name             = "FSS0_DAT_REGION";
mmu_armv84.vAddr             = 0x60000000;
mmu_armv84.pAddr             = 0x60000000;
mmu_armv84.size              = 0x4000000;
mmu_armv84.attribute         = "MAIR0";

/**
 * CLEC region.
 * Region start:  0x6AA00000
 * Region end:  0x6AB00000
 * Read and write for both privileged and user modes.
 * No Execute for both privileged and user modes.
 * Attribute is MAIR0.
 */
mmu_armv85.$name = "CLEC";
mmu_armv85.size  = 0x100000;
mmu_armv85.vAddr = 0x6AA00000;
mmu_armv85.pAddr = 0x6AA00000;
mmu_armv85.attribute = "MAIR0";

/**
 * DRU region.
 * Region start: 0x6AC00000
 * Region end: 0x6AD00000
 * Read and write for both privileged and user modes.
 * No Execute for both privileged and user modes.
 * Attribute is MAIR0.
 */
mmu_armv86.$name = "DRU";
mmu_armv86.size  = 0x100000;
mmu_armv86.vAddr = 0x6AC00000;
mmu_armv86.pAddr = 0x6AC00000;
mmu_armv86.attribute = "MAIR0";
